## esp-csi/examples/get-started/csi_between_devices/main/Kconfig.projbuild
```kconfig
menu "CSI between devices (Espressif 4.2)"

    choice CSI_BETWEEN_ROLE
        prompt "Board role"
        default CSI_BETWEEN_ROLE_SENSE
        help
            Peer board uses a fixed STA MAC and only generates traffic (ping).
            Sense board joins the same AP, pings, and measures CSI from the peer MAC.

        config CSI_BETWEEN_ROLE_PEER
            bool "Peer (traffic source)"
        config CSI_BETWEEN_ROLE_SENSE
            bool "Sense (CSI from peer)"
    endchoice

endmenu

menu "CSI TCP forwarder (sense → Mini)"

config CSI_TCP_ENABLE
    bool "Forward CSI_DATA lines over TCP (sense board)"
    default y
    depends on CSI_BETWEEN_ROLE_SENSE
    help
        Sense board only: each CSI_DATA line is also sent to CONFIG_CSI_TCP_HOST
        (Mac Mini collect / ingest on :9055). Peer does not enable this.
        USB serial printing still works when plugged in.

config CSI_TCP_HOST
    string "Ingest host IPv4 address"
    depends on CSI_TCP_ENABLE
    default "10.128.93.13"
    help
        LabPSK IP of the Mini running collect_session / listen-tcp 9055.

config CSI_TCP_PORT
    int "Ingest TCP port"
    depends on CSI_TCP_ENABLE
    range 1 65535
    default 9055

endmenu
```

## esp-csi/examples/get-started/csi_between_devices/sdkconfig.defaults.sense
```kconfig
CONFIG_CSI_BETWEEN_ROLE_SENSE=y
# CONFIG_CSI_BETWEEN_ROLE_PEER is not set
CONFIG_CSI_TCP_ENABLE=y
```

## esp-csi/examples/get-started/csi_recv_router/main/Kconfig.projbuild
```kconfig
# Wireless CSI forwarder (TCP client → ingest host)

menu "CSI TCP forwarder"

config CSI_TCP_ENABLE
    bool "Forward CSI_DATA lines over TCP"
    default n
    help
        When enabled, each CSI_DATA line is also sent to CONFIG_CSI_TCP_HOST
        (Mac Mini / laptop ingest listener). USB serial printing still works.

config CSI_TCP_HOST
    string "Ingest host IPv4 address"
    depends on CSI_TCP_ENABLE
    default "10.128.93.1"
    help
        LabPSK IP of the machine running: ./run_ingest.sh --listen-tcp

config CSI_TCP_PORT
    int "Ingest TCP port"
    depends on CSI_TCP_ENABLE
    range 1 65535
    default 9055

endmenu
```
